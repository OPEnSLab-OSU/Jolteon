## CMakeLists.txt
```
#
# Copyright (c) 2022 Nordic Semiconductor ASA
#
# SPDX-License-Identifier: LicenseRef-Nordic-5-Clause
#

cmake_minimum_required(VERSION 3.20.0)

find_package(Zephyr REQUIRED HINTS $ENV{ZEPHYR_BASE})
project(nrf_wifi_sta)

target_include_directories(app PUBLIC
	${CMAKE_CURRENT_SOURCE_DIR}/src
	${ZEPHYR_BASE}/subsys/net/ip
)

target_sources(app PRIVATE
	src/main.c
	src/wt_app.c
	src/wt_at.c
	src/wt_ble.c
	src/wt_common.c
	src/wt_leds.c
	src/wt_radio.c
	src/wt_shell.c
	src/wt_stream.c
	src/wt_tx_route.c
	src/wt_wifi.c
	src/wt_winc_at.c
	src/wt_winc_wire.c
)
```

## prj.conf
```kconfig
# WT02E40E nRF5340 + nRF7002 Wi-Fi/BLE command bring-up.

# Default boot behavior while the Wi-Fi antenna is missing.
CONFIG_WT02E40E_DEFAULT_BLE=y

# Wi-Fi
CONFIG_WIFI=y
CONFIG_WIFI_NRF70=y
CONFIG_WIFI_NM_WPA_SUPPLICANT=y
CONFIG_WIFI_READY_LIB=y

# Wi-Fi credentials. Static credentials are the compiled fallback, and the UART/RTT
# shell can store a runtime override in the Zephyr credentials backend.
CONFIG_WIFI_CREDENTIALS=y
CONFIG_WIFI_CREDENTIALS_MAX_ENTRIES=4
CONFIG_WIFI_CREDENTIALS_BACKEND_SETTINGS=y
CONFIG_SETTINGS=y
CONFIG_SETTINGS_NVS=y
CONFIG_NVS=y
CONFIG_FLASH=y
CONFIG_FLASH_PAGE_LAYOUT=y
CONFIG_FLASH_MAP=y
CONFIG_WIFI_CREDENTIALS_STATIC=y
CONFIG_WIFI_CREDENTIALS_STATIC_SSID="Myssid"
CONFIG_WIFI_CREDENTIALS_STATIC_PASSWORD="Mypassword"

# BLE peripheral advertising.
CONFIG_BT=y
CONFIG_BT_PERIPHERAL=y
CONFIG_BT_DEVICE_NAME="WT02E40E-CMD"
CONFIG_BT_DEVICE_NAME_DYNAMIC=y
CONFIG_BT_DEVICE_NAME_MAX=32
CONFIG_BT_MAX_CONN=1
CONFIG_BT_BUF_ACL_TX_COUNT=3
CONFIG_BT_BUF_EVT_RX_COUNT=10
CONFIG_BT_RX_STACK_SIZE=2048

# BLE ATT MTU / L2CAP buffers.
# App-level command/status payloads are capped at 255 bytes, but notifications use
# the negotiated ATT MTU dynamically. With MTU 256, usable ATT payload is 253 bytes.
CONFIG_BT_L2CAP_TX_MTU=256
CONFIG_BT_BUF_ACL_RX_SIZE=260
CONFIG_BT_BUF_ACL_TX_SIZE=260

# UART/RTT command shell.
CONFIG_SERIAL=y
CONFIG_CONSOLE=y
CONFIG_UART_CONSOLE=y
CONFIG_UART_INTERRUPT_DRIVEN=y
CONFIG_SHELL=y
CONFIG_SHELL_BACKEND_SERIAL=y
CONFIG_SHELL_BACKEND_SERIAL_RX_RING_BUFFER_SIZE=2048
CONFIG_SHELL_BACKEND_SERIAL_TX_RING_BUFFER_SIZE=256
CONFIG_NET_DHCPV4_OPTION_CALLBACKS=y
CONFIG_DNS_RESOLVER=y
CONFIG_SHELL_BACKEND_RTT=y
CONFIG_SHELL_STACK_SIZE=4096
CONFIG_SHELL_CMDS_RESIZE=n
CONFIG_USE_SEGGER_RTT=y

# Networking
CONFIG_NETWORKING=y
CONFIG_NET_SOCKETS=y
CONFIG_NET_LOG=y
CONFIG_NET_IPV4=y
CONFIG_NET_UDP=y
CONFIG_NET_TCP=y
CONFIG_NET_DHCPV4=y

CONFIG_NET_PKT_RX_COUNT=16
CONFIG_NET_PKT_TX_COUNT=16
CONFIG_NRF70_RX_NUM_BUFS=16

# Wi-Fi memory tuning from Nordic STA sample.
CONFIG_NET_BUF_RX_COUNT=16
CONFIG_NET_BUF_TX_COUNT=32
CONFIG_HEAP_MEM_POOL_SIZE=37000
CONFIG_HEAP_MEM_POOL_IGNORE_MIN=y
CONFIG_NRF_WIFI_CTRL_HEAP_SIZE=20000
CONFIG_NRF_WIFI_DATA_HEAP_SIZE=40000
CONFIG_NET_TC_TX_COUNT=1

CONFIG_NET_IF_UNICAST_IPV4_ADDR_COUNT=1
CONFIG_NET_MAX_CONTEXTS=16
CONFIG_NET_MAX_CONN=19
CONFIG_NET_CONTEXT_SYNC_RECV=y

CONFIG_NET_L2_ETHERNET=y
CONFIG_NET_L2_ETHERNET_MGMT=y

CONFIG_NET_CONFIG_SETTINGS=y
CONFIG_NET_CONFIG_INIT_TIMEOUT=0
CONFIG_NET_CONFIG_MY_IPV4_ADDR="192.168.1.99"
CONFIG_NET_CONFIG_MY_IPV4_NETMASK="255.255.255.0"
CONFIG_NET_CONFIG_MY_IPV4_GW="192.168.1.1"

CONFIG_ZVFS_POLL_MAX=10

# Memory
CONFIG_MAIN_STACK_SIZE=5200
CONFIG_NET_TX_STACK_SIZE=4096
CONFIG_NET_RX_STACK_SIZE=4096
CONFIG_STA_SAMPLE_START_WIFI_THREAD_STACK_SIZE=6144
CONFIG_SYSTEM_WORKQUEUE_STACK_SIZE=4096

# Kernel
CONFIG_GPIO=y
CONFIG_ENTROPY_GENERATOR=y
CONFIG_INIT_STACKS=y

# Logging / debug
CONFIG_LOG=y
CONFIG_LOG_DEFAULT_LEVEL=3
CONFIG_LOG_BUFFER_SIZE=4096
CONFIG_LOG_BACKEND_RTT=n
CONFIG_LOG_BACKEND_UART=n
CONFIG_SHELL_LOG_BACKEND=y
CONFIG_POSIX_TIMERS=y
CONFIG_STACK_SENTINEL=y
CONFIG_DEBUG_COREDUMP=y
CONFIG_DEBUG_COREDUMP_BACKEND_LOGGING=y
CONFIG_DEBUG_COREDUMP_MEMORY_DUMP_MIN=y

# Printing scan/status results can put pressure on queues in crowded environments.
CONFIG_NET_MGMT_EVENT_QUEUE_TIMEOUT=5000

# Reboot command support
CONFIG_REBOOT=y
```

## src/wt_at.c
```c
/* ESP-AT and WINC1500 UART compatibility on the bridge's shell transport. */
#include <errno.h>
#include <string.h>
#include <strings.h>

#include <zephyr/init.h>
#include <zephyr/kernel.h>
#include <zephyr/logging/log_backend.h>
#include <zephyr/shell/shell.h>
#include <zephyr/shell/shell_uart.h>
#include <zephyr/sys/atomic.h>
#include <zephyr/sys/printk.h>
#include <zephyr/version.h>

#include "wt_app.h"
#include "wt_ble.h"
#include "wt_config.h"
#include "wt_wifi.h"
#include "wt_winc_at.h"

#define WINC_SYNC_IDLE_MS 250
#define WINC_FRAME_IDLE_MS 500
#define WINC_POLL_MS 40

/* Only the UART shell thread owns this state. */
static char at_line[256];
static size_t at_length;
static bool at_discard;
static bool at_echo;
static bool at_active;
static bool at_winc;
static bool at_service_enabled;
static bool sync_reply_pending;
static bool service_pending;
static bool frame_timeout_pending;
static atomic_t poll_due;
static bool stream_active;
static bool stream_discard;
static bool stream_end_prefix;
static struct wt_winc_frame stream_frame;
static int64_t stream_last;
static struct shell_transport_api uart_at_api;
static shell_transport_handler_t uart_handler;
static void *uart_context;
#if defined(CONFIG_SHELL_LOG_BACKEND)
static bool restore_logs;
#endif

extern struct shell_transport shell_transport_uart;
static void at_receive(const struct shell *sh, uint8_t *data, size_t length, void *user);

static void winc_poll(struct k_timer *timer)
{
	ARG_UNUSED(timer);
	atomic_set(&poll_due, 1);
	uart_handler(SHELL_TRANSPORT_EVT_RX_RDY, uart_context);
}
K_TIMER_DEFINE(winc_timer, winc_poll, NULL);

static void enable_winc_service(void)
{
	if (!at_service_enabled) {
		at_service_enabled = true;
		k_timer_start(&winc_timer, K_MSEC(WINC_POLL_MS), K_MSEC(WINC_POLL_MS));
	}
}

/* Parse one ESP-AT quoted field in place, leaving the cursor at its delimiter. */
static char *quoted_arg(char **cursor)
{
	char *source = *cursor;
	char *value;
	char *dest;

	if (*source++ != '"') {
		return NULL;
	}
	value = dest = source;
	while (*source && *source != '"') {
		if (*source == '\\') {
			++source;
			if (*source != '\\' && *source != '"' && *source != ',') {
				return NULL;
			}
		}
		*dest++ = *source++;
	}
	if (*source != '"') {
		return NULL;
	}
	*cursor = source + 1;
	*dest = '\0';
	return value;
}

static void escape_field(const char *input, char *output, size_t size)
{
	while (*input && size > 2) {
		unsigned char c = *input++;

		if (c == '"' || c == ',' || c == '\\') {
			*output++ = '\\';
			--size;
		}
		*output++ = (c < 32 || c == 127) ? '?' : c;
		--size;
	}
	*output = '\0';
}

static int wifi_security_number(enum wifi_security_type security)
{
	switch (security) {
	case WIFI_SECURITY_TYPE_NONE: return 0;
	case WIFI_SECURITY_TYPE_WEP:
	case WIFI_SECURITY_TYPE_WEP_OPEN:
	case WIFI_SECURITY_TYPE_WEP_SHARED: return 1;
	case WIFI_SECURITY_TYPE_WPA_PSK: return 2;
	case WIFI_SECURITY_TYPE_PSK:
	case WIFI_SECURITY_TYPE_PSK_SHA256:
	case WIFI_SECURITY_TYPE_FT_PSK: return 3;
	case WIFI_SECURITY_TYPE_EAP: return 5;
	case WIFI_SECURITY_TYPE_SAE:
	case WIFI_SECURITY_TYPE_SAE_H2E:
	case WIFI_SECURITY_TYPE_SAE_AUTO:
	case WIFI_SECURITY_TYPE_FT_SAE: return 6;
	case WIFI_SECURITY_TYPE_WAPI: return 8;
	case WIFI_SECURITY_TYPE_DPP: return 13;
	default: return -1;
	}
}

static void format_mac(char mac[18], const uint8_t *addr)
{
	snprintk(mac, 18, "%02x:%02x:%02x:%02x:%02x:%02x",
		 addr[0], addr[1], addr[2], addr[3], addr[4], addr[5]);
}

static void print_scan_entry(const char *ssid, int rssi, unsigned int channel,
			     enum wifi_security_type security, const uint8_t *bssid, void *user)
{
	const struct shell *sh = user;
	char escaped[2 * WIFI_SSID_MAX_LEN + 1];
	char mac[18] = "";

	escape_field(ssid, escaped, sizeof(escaped));
	if (bssid) {
		format_mac(mac, bssid);
	}
	shell_print(sh, "+CWLAP:(%d,\"%s\",%d,\"%s\",%u)",
		    wifi_security_number(security), escaped, rssi, mac, channel);
}

static int wifi_query(const struct shell *sh, bool join_query)
{
	struct wifi_iface_status status = { 0 };
	char ssid[2 * WIFI_SSID_MAX_LEN + 1] = "";
	bool requested = wt_wifi_is_requested();
	int state = 0;

	if (requested) {
		int ret = wt_wifi_station_status(&status);

		if (ret) {
			return ret;
		}
		if (wt_wifi_is_associated()) {
			state = wt_wifi_has_ipv4() ? 2 : 1;
		} else if (status.state >= WIFI_STATE_SCANNING && status.state <= WIFI_STATE_COMPLETED) {
			state = 3;
		} else {
			state = 4;
		}
		status.ssid[WIFI_SSID_MAX_LEN] = '\0';
		escape_field(status.ssid, ssid, sizeof(ssid));
	}
	if (!join_query) {
		shell_print(sh, "+CWSTATE:%d,\"%s\"", state, ssid);
		return 0;
	}
	if (state == 1 || state == 2) {
		char mac[18];

		format_mac(mac, (const uint8_t *)status.bssid);
		shell_print(sh, "+CWJAP:\"%s\",\"%s\",%u,%d", ssid, mac, status.channel, status.rssi);
	} else {
		shell_print(sh, "No AP");
	}
	return 0;
}

static int wifi_join(const struct shell *sh, char *args)
{
	char *ssid = quoted_arg(&args);
	char *password;
	int ret;

	if (!ssid || *args++ != ',') {
		return -EINVAL;
	}
	password = quoted_arg(&args);
	if (!password || *args) {
		return -EINVAL;
	}
	if (!wt_wifi_is_requested()) {
		return -ENODEV;
	}
	wt_winc_close_all();
	ret = wt_wifi_station_join(ssid, password);
	if (!ret) {
		shell_print(sh, "WIFI CONNECTED\nWIFI GOT IP");
	} else if (ret == -ETIMEDOUT) {
		shell_print(sh, "+CWJAP:1");
	} else {
		shell_print(sh, "+CWJAP:4");
	}
	return ret;
}

static int at_execute(const struct shell *sh, char *line)
{
	if (!strcmp(line, "AT")) {
		return 0;
	}
	if (!strcmp(line, "ATE0") || !strcmp(line, "ATE1")) {
		at_echo = line[3] == '1';
		return 0;
	}
	if (!strcmp(line, "AT+GMR")) {
		shell_print(sh, "AT version:WT02E40E subset 1\nSDK version:Zephyr " KERNEL_VERSION_STRING
			    "\nBin version:" WT_APP_FW_VERSION);
		return 0;
	}
	if (!strcmp(line, "AT+RST")) {
		return wt_app_reboot_schedule(false, WT_APP_REBOOT_DELAY_MS);
	}
	if (!strcmp(line, "AT+CWMODE?")) {
		shell_print(sh, "+CWMODE:%d", wt_wifi_is_requested() ? 1 : 0);
		return 0;
	}
	if (!strcmp(line, "AT+CWMODE=0") || !strcmp(line, "AT+CWMODE=1")) {
		if (line[10] == '0') {
			wt_winc_close_all();
		}
		return wt_wifi_service_set(line[10] == '1');
	}
	if (!strcmp(line, "AT+CWSTATE?") || !strcmp(line, "AT+CWJAP?")) {
		return wifi_query(sh, !strcmp(line, "AT+CWJAP?"));
	}
	if (!strncmp(line, "AT+CWJAP=", 9)) {
		return wifi_join(sh, line + 9);
	}
	if (!strcmp(line, "AT+CWQAP")) {
		wt_winc_close_all();
		return wt_wifi_station_leave();
	}
	if (!strcmp(line, "AT+CWLAP")) {
		return wt_wifi_is_requested() ? wt_wifi_scan_visit(0, print_scan_entry, (void *)sh) : -ENODEV;
	}
	if (!strcmp(line, "AT+CIFSR") || !strcmp(line, "AT+CIPSTAMAC?")) {
		char mac[18];
		char ip[16];
		int ret = wt_wifi_mac_get(mac, sizeof(mac));

		if (ret) {
			return ret;
		}
		if (!strcmp(line, "AT+CIFSR")) {
			wt_wifi_ipv4_get(ip, sizeof(ip));
			shell_print(sh, "+CIFSR:STAIP,\"%s\"\n+CIFSR:STAMAC,\"%s\"", ip, mac);
		} else {
			shell_print(sh, "+CIPSTAMAC:\"%s\"", mac);
		}
		return 0;
	}
	if (!strcmp(line, "AT+BLEINIT?")) {
		shell_print(sh, "+BLEINIT:%d", wt_ble_is_requested() && wt_ble_is_ready() ? 2 : 0);
		return 0;
	}
	if (!strcmp(line, "AT+BLEINIT=2")) {
		return wt_ble_peripheral_enable();
	}
	if (!strcmp(line, "AT+BLEINIT=0")) {
		return wt_ble_service_stop();
	}
	if (!strncmp(line, "AT+BLE", 6) && (!wt_ble_is_requested() || !wt_ble_is_ready())) {
		return -ENOTSUP;
	}
	if (!strcmp(line, "AT+BLEADVSTART") || !strcmp(line, "AT+BLEADVSTOP")) {
		return wt_ble_advertise_set(!strcmp(line, "AT+BLEADVSTART"));
	}
	if (!strcmp(line, "AT+BLEADDR?")) {
		char address[18];
		int ret = wt_ble_address_get(address, sizeof(address));

		if (!ret) {
			shell_print(sh, "+BLEADDR:\"%s\"", address);
		}
		return ret;
	}
	if (!strcmp(line, "AT+BLENAME?")) {
		char name[2 * WT_BLE_NAME_MAX + 1];

		escape_field(wt_ble_name_get(), name, sizeof(name));
		shell_print(sh, "+BLENAME:%s", name);
		return 0;
	}
	if (!strncmp(line, "AT+BLENAME=", 11)) {
		char *args = line + 11;
		char *name = quoted_arg(&args);

		/* The legacy scan response has 31 bytes, including two for the AD header. */
		return name && !*args && strlen(name) <= 29 ? wt_ble_name_set(name) : -EINVAL;
	}
	return -ENOEXEC;
}

static void enter_at(const struct shell *sh, bool winc)
{
	if (!at_active) {
#if defined(CONFIG_SHELL_LOG_BACKEND)
		restore_logs = sh->log_backend && log_backend_is_active(sh->log_backend->backend);
		if (restore_logs) {
			log_backend_deactivate(sh->log_backend->backend);
		}
#endif
		at_active = true;
	}
	memset(at_line, 0, sizeof(at_line));
	at_length = 0;
	at_discard = false;
	at_echo = false;
	at_winc = winc;
	stream_active = false;
	shell_set_bypass(sh, at_receive, NULL);
	if (winc) {
		enable_winc_service();
	}
}

static void line_reply(const struct shell *sh)
{
	int ret;

	if (at_discard) {
		shell_print(sh, "%s", at_winc ? "+ERROR+AT:-106" : "ERROR");
		return;
	}
	if (at_echo) {
		shell_print(sh, "%s", at_line);
	}
	if (at_winc && !strcasecmp(at_line, "AT")) {
		shell_print(sh, "+OK+AT=Ver:" WT_WINC_AT_VERSION);
		return;
	}
	if (wt_winc_command(sh, at_line, &at_echo)) {
		enable_winc_service();
		return;
	}
	ret = at_execute(sh, at_line);
	if (at_winc && ret == -ENOEXEC) {
		const char *name = !strncasecmp(at_line, "AT+", 3) ? at_line + 3 : "AT";
		size_t len = strspn(name, "0123456789ABCDEFGHIJKLMNOPQRSTUVWXYZabcdefghijklmnopqrstuvwxyz");

		shell_print(sh, "+ERROR+%.*s:-102", (int)MIN(len, 20), len ? name : "AT");
	} else {
		shell_print(sh, "%s", ret ? "ERROR" : "OK");
	}
}

static void stream_receive(const struct shell *sh, uint8_t c)
{
	enum wt_winc_frame_result result;

	stream_last = k_uptime_get();
	if (stream_discard) {
		if (stream_end_prefix && c == 'E') {
			stream_active = false;
		}
		stream_end_prefix = c == WT_WINC_SOH;
		return;
	}

	result = wt_winc_frame_feed(&stream_frame, c);
	switch (result) {
	case WT_WINC_FRAME:
		stream_active = false;
		wt_winc_stream_command(sh, &stream_frame);
		break;
	case WT_WINC_BAD_HEADER:
	case WT_WINC_BAD_DATA:
		shell_print(sh, "+ERROR+STREAM:%d", result == WT_WINC_BAD_HEADER ? -109 : -110);
		stream_discard = true;
		stream_end_prefix = c == WT_WINC_SOH;
		break;
	case WT_WINC_MORE:
		break;
	}
}

static void at_receive(const struct shell *sh, uint8_t *data, size_t length, void *user)
{
	ARG_UNUSED(user);
	if (sync_reply_pending) {
		sync_reply_pending = false;
		wt_winc_close_all();
		shell_print(sh, "+OK+AT=AT:" WT_WINC_AT_VERSION ",FW:WT02E40E,ChipID:5340,RFRev0");
		return;
	}
	if (service_pending) {
		service_pending = false;
		wt_winc_service(sh);
		return;
	}
	if (frame_timeout_pending) {
		frame_timeout_pending = false;
		shell_print(sh, "+ERROR+STREAM:-110");
		return;
	}
	for (size_t i = 0; i < length; ++i) {
		uint8_t c = data[i];

		if (stream_active) {
			stream_receive(sh, c);
		} else if (c == WT_WINC_SOH && !at_length && !at_discard) {
			memset(&stream_frame, 0, sizeof(stream_frame));
			stream_active = true;
			stream_discard = false;
			stream_end_prefix = false;
			stream_last = k_uptime_get();
		} else if (c == '\r' || c == '\n') {
			if (!at_length && !at_discard) {
				continue;
			}
			at_line[at_length] = '\0';
			if (!at_discard && !(at_winc ? strcasecmp(at_line, "ATO") : strcmp(at_line, "ATO"))) {
				memset(at_line, 0, sizeof(at_line));
				wt_winc_close_all();
				shell_print(sh, "OK");
#if defined(CONFIG_SHELL_LOG_BACKEND)
				if (restore_logs) {
					log_backend_activate(sh->log_backend->backend, (void *)sh);
				}
#endif
				at_active = false;
				at_winc = false;
				at_service_enabled = false;
				k_timer_stop(&winc_timer);
				atomic_clear(&poll_due);
				shell_set_bypass(sh, NULL, NULL);
				return;
			}
			line_reply(sh);
			memset(at_line, 0, sizeof(at_line));
			at_length = 0;
			at_discard = false;
		} else if (c < 32 || c == 127 || at_length == sizeof(at_line) - 1) {
			at_discard = true;
		} else if (!at_discard) {
			at_line[at_length++] = c;
		}
	}
}

/* Check for WINC startup before the native shell consumes binary control
 * characters. Take one byte per read so state changes never swallow a chunk.
 */
static int uart_at_read(const struct shell_transport *transport, void *buffer, size_t len,
			size_t *count)
{
	static uint8_t pending[WT_WINC_SYNC_LENGTH];
	static size_t matched, replay_pos, replay_end;
	static int64_t sync_last;
	uint8_t *data = buffer;

	*count = 0;
	if (!len) {
		return 0;
	}
	if (sync_reply_pending) {
		*data = '\n'; /* Schedule the response in the unlocked bypass callback. */
		*count = 1;
		return 0;
	}
	if (replay_pos < replay_end) {
		*data = pending[replay_pos++];
		*count = 1;
		return 0;
	}
	for (;;) {
		int ret = shell_uart_transport_api.read(transport, data, 1, count);
		int64_t now = k_uptime_get();
		size_t previous = matched;

		if (ret) {
			return ret;
		}
		if (stream_active && now - stream_last > WINC_FRAME_IDLE_MS) {
			stream_active = false;
			if (!stream_discard && !*count) {
				*data = '\n';
				*count = 1;
				frame_timeout_pending = true;
				return 0;
			}
		}
		if (!*count) {
			if (at_service_enabled && !stream_active && !at_length && !at_discard &&
			    atomic_cas(&poll_due, 1, 0)) {
				*data = '\n';
				*count = 1;
				service_pending = true;
			}
			return 0;
		}
		if (stream_active) {
			return 0;
		}
		if (matched && now - sync_last > WINC_SYNC_IDLE_MS) {
			matched = 0;
			previous = 0;
		}
		sync_last = now;
		switch (wt_winc_sync_feed(&matched, *data)) {
		case WT_WINC_SYNC:
			enter_at(shell_backend_uart_get_ptr(), true);
			sync_reply_pending = true;
			uart_handler(SHELL_TRANSPORT_EVT_RX_RDY, uart_context);
			*count = 0;
			return 0;
		case WT_WINC_PREFIX:
			if (!previous || matched > 1) {
				pending[matched - 1] = *data;
				break;
			}
			/* A second A5 starts a new prefix. The old one was not sync. */
			replay_end = previous;
			replay_pos = 1;
			*data = pending[0];
			return 0;
		case WT_WINC_TEXT:
			if (previous) {
				pending[previous] = *data;
				replay_end = previous + 1;
				replay_pos = 1;
				*data = pending[0];
			}
			return 0;
		}
	}
}

static int uart_at_init(const struct shell_transport *transport, const void *config,
			shell_transport_handler_t handler, void *context)
{
	uart_handler = handler;
	uart_context = context;
	return shell_uart_transport_api.init(transport, config, handler, context);
}

static int uart_at_install(void)
{
	uart_at_api = shell_uart_transport_api;
	uart_at_api.init = uart_at_init;
	uart_at_api.read = uart_at_read;
	shell_transport_uart.api = &uart_at_api;
	return 0;
}
SYS_INIT(uart_at_install, PRE_KERNEL_2, 50);

static int at_start(const struct shell *sh, size_t argc, char **argv)
{
	ARG_UNUSED(argc);
	ARG_UNUSED(argv);
	if (sh != shell_backend_uart_get_ptr()) {
		shell_print(sh, "ERROR");
		return -ENOTSUP;
	}
	enter_at(sh, false);
	shell_print(sh, "OK");
	return 0;
}

SHELL_CMD_ARG_REGISTER(AT, NULL, "Enter UART AT mode. ATO returns to the WT shell.", at_start, 1, 0);
```

## src/wt_ble.h
```c
#ifndef WT_BLE_H
#define WT_BLE_H

#include <stdbool.h>
#include <stddef.h>
#include <stdint.h>

bool wt_ble_is_requested(void);
bool wt_ble_is_ready(void);
bool wt_ble_is_advertising(void);
bool wt_ble_is_connected(void);
bool wt_ble_tx_notify_is_enabled(void);
bool wt_ble_status_notify_is_enabled(void);
bool wt_ble_cmd_response_notify_is_enabled(void);
const char *wt_ble_name_get(void);
int wt_ble_name_set(const char *name);

void wt_ble_init(void);
int wt_ble_service_start(void);
int wt_ble_service_stop(void);
int wt_ble_peripheral_enable(void);
int wt_ble_advertise_set(bool enable);
int wt_ble_address_get(char *buf, size_t size);
int wt_ble_transmit_payload(const uint8_t *data, size_t len);
int wt_ble_status_format(char *buf, size_t size);

#endif /* WT_BLE_H */
```

## src/wt_wifi.h
```c
#ifndef WT_WIFI_H
#define WT_WIFI_H

#include <errno.h>
#include <stdbool.h>
#include <stddef.h>
#include <stdint.h>

#include <zephyr/shell/shell.h>
#include <zephyr/net/wifi_mgmt.h>

typedef int (*wt_wifi_stream_emit_fn)(const char *data, size_t len, void *user);
typedef void (*wt_wifi_scan_visit_fn)(const char *ssid, int rssi, unsigned int channel,
				     enum wifi_security_type security, const uint8_t *bssid,
				     void *user);

bool wt_wifi_is_requested(void);
bool wt_wifi_is_associated(void);
bool wt_wifi_has_ipv4(void);
int wt_wifi_ipv4_get(char *buf, size_t size);
struct wt_wifi_ipv4_config {
	char ip[16], subnet[16], gateway[16], dns[16];
};
int wt_wifi_ipv4_config_get(struct wt_wifi_ipv4_config *config);
int wt_wifi_mac_get(char *buf, size_t size);

int wt_wifi_init(void);
int wt_wifi_service_set(bool enable);
int wt_wifi_status_log(void);
int wt_wifi_station_status(struct wifi_iface_status *status);
int wt_wifi_station_join(const char *ssid, const char *password);
int wt_wifi_station_join_channel(const char *ssid, const char *password, unsigned int channel);
int wt_wifi_station_leave(void);
int wt_wifi_credentials_print_list(const struct shell *sh);
int wt_wifi_credentials_format_list(char *buf, size_t buf_len);
int wt_wifi_credentials_set(const char *ssid, const char *password, const char *security_text, bool replace_all);
int wt_wifi_credentials_open(const char *ssid, bool replace_all);
int wt_wifi_credentials_forget(const char *ssid);
int wt_wifi_credentials_clear(void);
int wt_wifi_credentials_shell(const struct shell *sh, size_t argc, char **argv);
int wt_wifi_reconnect_if_requested(void);
int wt_wifi_udp_transmit_payload(const char *ip_text, const char *port_text,
					const uint8_t *data, size_t len);
int wt_wifi_udp_transmit_stream_payload(const char *ip_text, const char *port_text,
					       const uint8_t *data, size_t len);
int wt_wifi_cmd_service_set(bool enable);
bool wt_wifi_cmd_is_enabled(void);
uint16_t wt_wifi_cmd_port(void);
int wt_wifi_cmd_port_set(uint16_t port);
int wt_wifi_discovery_service_set(bool enable);
bool wt_wifi_discovery_is_enabled(void);
int wt_wifi_command_execute(const char *line, char *rsp, size_t rsp_len);
int wt_wifi_scan_command(char **argv, size_t argc, char *rsp, size_t rsp_len);
int wt_wifi_scan_format_results(char *buf, size_t size, bool json);
int wt_wifi_scan_stream_json(wt_wifi_stream_emit_fn emit, void *user);
bool wt_wifi_scan_is_running(void);
int wt_wifi_scan_count(void);
int wt_wifi_scan_visit(unsigned int channel, wt_wifi_scan_visit_fn visit, void *user);

#ifdef CONFIG_WIFI_READY_LIB
int wt_wifi_register_ready_callback(void);
void wt_wifi_start_worker(void);
#else
static inline int wt_wifi_register_ready_callback(void)
{
	return -ENOTSUP;
}

static inline void wt_wifi_start_worker(void)
{
}
#endif

#endif /* WT_WIFI_H */
```

## src/wt_winc_at.c
```c
#include <errno.h>
#include <stdlib.h>
#include <string.h>
#include <strings.h>

#include <zephyr/kernel.h>
#include <zephyr/net/socket.h>
#include <zephyr/sys/fdtable.h>
#include <zephyr/sys/printk.h>
#include <zephyr/sys/util.h>

#include "wt_wifi.h"
#include "wt_winc_at.h"

#define WINC_TCP_COUNT 7
#define WINC_SOCKET_COUNT 11
#define WINC_SOCKET_TIMEOUT_MS 5000

/* Owned by the UART AT session. Store fd + 1 so the zero state is free. */
static struct winc_socket {
	int handle;
	struct sockaddr_in peer;
	bool send_event;
	bool auto_receive;
} sockets[WINC_SOCKET_COUNT];
static uint8_t rx_payload[WT_WINC_PAYLOAD_MAX];
static bool station_connected;

static const struct {
	const char *name;
	const char *args;
} commands[] = {
	{ "VER", "" }, { "LIST", "" }, { "ECHO", "=<0|1>" }, { "ECHO?", "" },
	{ "SCAN", "[=<channel>]" }, { "DHCP", "=1" },
	{ "CONN", "=<ssid>,<security>[,<key>][,<channel>]" },
	{ "MODE", "" }, { "DISMODE", "" }, { "GETMAC", "" }, { "GETIP", "" },
	{ "RSSI", "" }, { "RESDNS", "=<host>" },
	{ "TCPCLI", "=<ip>,<port>[,0[,<auto recv>]]" },
	{ "UDP", "=<local port>[,<ip>[,<port>[,<auto recv>]]]" },
	{ "UDPCFG", "=<socket>,<ip>,<port>" }, { "UDPCB", "=<socket>,<0|1>" },
	{ "CLOSE", "=<socket>" }, { "CLOSEALL", "" },
};

static unsigned int split_fields(char *text, char **fields, unsigned int max)
{
	unsigned int count = 0;
	while (text && count < max) {
		char *comma = strchr(text, ',');
		fields[count++] = text;
		if (comma) {
			*comma++ = '\0';
		}
		text = comma;
	}
	return text ? max + 1 : count;
}

static int number(const char *text, unsigned int limit)
{
	unsigned int value = 0;
	if (!text || !*text) {
		return -1;
	}
	for (; *text >= '0' && *text <= '9'; ++text) {
		value = value * 10 + *text - '0';
		if (value > limit) {
			return -1;
		}
	}
	return *text ? -1 : (int)value;
}

static int parse_peer(struct sockaddr_in *peer, const char *ip, const char *port)
{
	struct sockaddr_in address = { .sin_family = AF_INET };
	int value = number(port, UINT16_MAX);

	if (value <= 0 || zsock_inet_pton(AF_INET, ip, &address.sin_addr) != 1) {
		return -301;
	}
	address.sin_port = htons(value);
	*peer = address;
	return 0;
}

static void close_socket(int id)
{
	(void)zsock_close(sockets[id].handle - 1);
	sockets[id] = (struct winc_socket){ 0 };
}

void wt_winc_close_all(void)
{
	for (int i = 0; i < WINC_SOCKET_COUNT; ++i) {
		if (sockets[i].handle) {
			close_socket(i);
		}
	}
}

static int existing_socket(const char *text)
{
	int id = text && *text && !text[1] ? wt_winc_socket_digit(*text) : -1;
	return id >= 0 && sockets[id].handle ? id : -300;
}

static int open_socket(const struct shell *sh, bool udp, char **args, unsigned int count)
{
	struct sockaddr_in peer = { .sin_family = AF_INET };
	struct sockaddr_in local = { .sin_family = AF_INET };
	int first = udp ? WINC_TCP_COUNT : 0;
	int end = udp ? WINC_SOCKET_COUNT : WINC_TCP_COUNT;
	int id = first;
	int auto_receive = 1;
	int fd, ret;

	if (!wt_wifi_has_ipv4()) {
		return -206;
	}
	if (udp) {
		if (!count || count > 4) {
			return -103;
		}
		int port = number(args[0], UINT16_MAX);
		if (port < 0) {
			return -301;
		}
		local.sin_port = htons(port);
		peer.sin_addr.s_addr = INADDR_BROADCAST;
		peer.sin_port = local.sin_port;
		if (count >= 2 && *args[1] &&
		    zsock_inet_pton(AF_INET, args[1], &peer.sin_addr) != 1) {
			return -301;
		}
		if (count >= 3 && *args[2]) {
			int remote_port = number(args[2], UINT16_MAX);

			if (remote_port <= 0) {
				return -301;
			}
			peer.sin_port = htons(remote_port);
		}
	} else {
		if (count < 2 || count > 4) {
			return -103;
		}
		if (parse_peer(&peer, args[0], args[1])) {
			return -301;
		}
		if (count >= 3 && *args[2] && strcmp(args[2], "0")) {
			return !strcmp(args[2], "1") ? -104 : -105;
		}
	}
	if (count == 4 && *args[3]) {
		auto_receive = number(args[3], 1);
		if (auto_receive < 0) {
			return -105;
		}
	}
	while (id < end && sockets[id].handle) {
		++id;
	}
	if (id == end) {
		return udp ? -304 : -303;
	}
	fd = zsock_socket(AF_INET, udp ? SOCK_DGRAM : SOCK_STREAM, 0);
	if (fd < 0) {
		return udp ? -304 : -303;
	}
	ret = zsock_fcntl(fd, ZVFS_F_SETFL, ZVFS_O_NONBLOCK);
	if (!ret && udp) {
		ret = zsock_bind(fd, (const struct sockaddr *)&local, sizeof(local));
	} else if (!ret) {
		ret = zsock_connect(fd, (const struct sockaddr *)&peer, sizeof(peer));
		if (ret < 0 && errno == EINPROGRESS) {
			struct zsock_pollfd pending = { .fd = fd, .events = ZSOCK_POLLOUT };
			int result = zsock_poll(&pending, 1, WINC_SOCKET_TIMEOUT_MS);
			int socket_error;
			socklen_t error_len = sizeof(socket_error);
			ret = result > 0 && !zsock_getsockopt(fd, SOL_SOCKET, SO_ERROR,
							     &socket_error, &error_len) && !socket_error ? 0 : -1;
		}
	}
	if (ret) {
		int error = errno;

		(void)zsock_close(fd);
		return udp && error == EADDRINUSE ? -302 : -107;
	}
	sockets[id] = (struct winc_socket){
		.handle = fd + 1, .peer = peer, .send_event = true, .auto_receive = auto_receive,
	};
	station_connected = true;
	shell_print(sh, "+OK+%s=%X", udp ? "UDP" : "TCPCLI", id);
	return 0;
}

static int raw_write(const struct shell *sh, const uint8_t *data, size_t length)
{
	int64_t deadline = k_uptime_get() + 2000;
	while (length && k_uptime_get() < deadline) {
		size_t count = 0;
		int ret = sh->iface->api->write(sh->iface, data, length, &count);
		if (ret) {
			return ret;
		}
		data += count;
		length -= count;
		if (!count) {
			k_sleep(K_MSEC(1));
		}
	}
	return length ? -ETIMEDOUT : 0;
}

static void socket_receive(const struct shell *sh, int id, bool requested)
{
	struct sockaddr_in peer = { 0 };
	socklen_t peer_len = sizeof(peer);
	bool udp = id >= WINC_TCP_COUNT;
	int64_t deadline = k_uptime_get() + WINC_SOCKET_TIMEOUT_MS;
	char header[48];
	int header_size;
	int size;

	do {
		size = zsock_recvfrom(sockets[id].handle - 1, rx_payload, sizeof(rx_payload),
				      ZSOCK_MSG_DONTWAIT, (struct sockaddr *)&peer, &peer_len);
		if (size >= 0 || errno != EAGAIN || !requested) {
			break;
		}
		k_sleep(K_MSEC(20));
	} while (k_uptime_get() < deadline);
	if (size < 0 || (!udp && size == 0)) {
		if (size >= 0 || errno != EAGAIN) {
			shell_print(sh, "+EVT+RECV=%X,%d", id, size == 0 ? -312 : -107);
			sockets[id].auto_receive = false;
		} else if (requested) {
			shell_print(sh, "+EVT+RECV=%X,-111", id);
		}
		return;
	}
	if (udp) {
		char ip[16];
		zsock_inet_ntop(AF_INET, &peer.sin_addr, ip, sizeof(ip));
		header_size = snprintk(header, sizeof(header), "+EVT+RECV=%X,%d,U,%s,%u,", id, size,
				      ip, ntohs(peer.sin_port));
	} else {
		header_size = snprintk(header, sizeof(header), "+EVT+RECV=%X,%d,T,", id, size);
	}
	if (header_size > 0 && (size_t)header_size < sizeof(header) &&
	    !raw_write(sh, (const uint8_t *)header, header_size) && !raw_write(sh, rx_payload, size)) {
		const uint8_t end = WT_WINC_ETB;
		(void)raw_write(sh, &end, 1);
	}
}

void wt_winc_service(const struct shell *sh)
{
	bool connected = wt_wifi_is_associated();

	if (station_connected && !connected) {
		wt_winc_close_all();
		shell_print(sh, "+EVT+DISCONN");
	}
	station_connected = connected;
	if (connected) {
		for (int id = 0; id < WINC_SOCKET_COUNT; ++id) {
			if (sockets[id].handle && sockets[id].auto_receive) {
				socket_receive(sh, id, false);
			}
		}
	}
}

void wt_winc_stream_command(const struct shell *sh, const struct wt_winc_frame *frame)
{
	int id = frame->socket;
	bool udp = id >= WINC_TCP_COUNT;
	struct winc_socket *socket = &sockets[id];
	struct sockaddr_in peer = socket->peer;
	const uint8_t *payload = frame->data + frame->payload_start;
	int64_t deadline;
	size_t sent = 0;
	int ret = 0;

	if (!socket->handle || !wt_wifi_has_ipv4()) {
		shell_print(sh, "+ERROR+%s=%d", frame->directive == 'R' ? "RECV" : "SEND",
			    socket->handle ? -206 : -300);
		return;
	}
	if (frame->directive == 'R') {
		socket_receive(sh, id, true);
		return;
	}
	if (frame->directive == 'U') {
		char address[24];
		char *args[2];
		size_t size = frame->payload_start - 8;
		if (!udp || size >= sizeof(address)) {
			shell_print(sh, "+ERROR+SEND=-301");
			return;
		}
		memcpy(address, frame->data + 7, size);
		address[size] = '\0';
		if (split_fields(address, args, 2) != 2 || parse_peer(&peer, args[0], args[1])) {
			shell_print(sh, "+ERROR+SEND=-301");
			return;
		}
	}
	if (udp && !peer.sin_port) {
		shell_print(sh, "+ERROR+SEND=-311");
		return;
	}
	deadline = k_uptime_get() + WINC_SOCKET_TIMEOUT_MS;
	while (sent < frame->payload_len && k_uptime_get() < deadline) {
		ret = zsock_sendto(socket->handle - 1, payload + sent, frame->payload_len - sent,
				   ZSOCK_MSG_DONTWAIT, udp ? (const struct sockaddr *)&peer : NULL,
				   udp ? sizeof(peer) : 0);
		if (ret > 0) {
			sent += ret;
			if (udp) {
				break;
			}
		} else if (ret < 0 && errno != EAGAIN) {
			break;
		} else {
			k_sleep(K_MSEC(20));
		}
	}
	if (!udp || socket->send_event || sent != frame->payload_len) {
		shell_print(sh, "+EVT+SEND=%X,%d", id, sent == frame->payload_len ? (int)sent :
			    k_uptime_get() >= deadline ? -111 : -107);
	}
}

struct winc_scan { const struct shell *sh; unsigned int count; };

static void scan_result(const char *ssid, int rssi, unsigned int channel,
			enum wifi_security_type security, const uint8_t *bssid, void *user)
{
	struct winc_scan *scan = user;
	int auth;
	char mac[18] = "";
	char name[WIFI_SSID_MAX_LEN + 1];
	size_t index = 0;

	if (!channel || channel > 14) {
		return;
	}
	switch (security) {
	case WIFI_SECURITY_TYPE_NONE: auth = 1; break;
	case WIFI_SECURITY_TYPE_PSK:
	case WIFI_SECURITY_TYPE_PSK_SHA256:
	case WIFI_SECURITY_TYPE_WPA_PSK: auth = 2; break;
	case WIFI_SECURITY_TYPE_WEP:
	case WIFI_SECURITY_TYPE_WEP_OPEN:
	case WIFI_SECURITY_TYPE_WEP_SHARED: auth = 3; break;
	case WIFI_SECURITY_TYPE_EAP: auth = 4; break;
	default: return;
	}
	if (bssid) {
		snprintk(mac, sizeof(mac), "%02x:%02x:%02x:%02x:%02x:%02x",
			 bssid[0], bssid[1], bssid[2], bssid[3], bssid[4], bssid[5]);
	}
	for (; index < sizeof(name) - 1 && ssid[index]; ++index) {
		unsigned char c = ssid[index];
		name[index] = c < 32 || c == 127 ? '?' : c;
	}
	name[index] = '\0';
	shell_print(scan->sh, "+EVT+SCAN=%u,%d,%d,%u,%s,%s", scan->count++, rssi, auth,
		    channel, mac, name);
}

static int join(const struct shell *sh, char **args, unsigned int count)
{
	struct wt_wifi_ipv4_config config;
	const char *password = "";
	int channel = 0;
	int ret;

	if (count < 2 || count > 4) {
		return -103;
	}
	if (!strcmp(args[1], "2")) {
		if (count < 3 || !*args[2]) {
			return -103;
		}
		password = args[2];
		channel = count == 4 ? number(args[3], 14) : 0;
	} else if (!strcmp(args[1], "1") && count <= 3) {
		channel = count == 3 ? number(args[2], 14) : 0;
	} else {
		return -105;
	}
	if (channel < 0) {
		return -105;
	}
	wt_winc_close_all();
	ret = wt_wifi_station_join_channel(args[0], password, channel);
	if (ret) {
		return ret == -ETIMEDOUT ? -111 : ret == -EBUSY ? -254 : ret == -EINVAL ? -105 : -251;
	}
	if (wt_wifi_ipv4_config_get(&config)) {
		return -206;
	}
	station_connected = true;
	shell_print(sh, "+OK+CONN\n+EVT+DHCP=%s,%s,%s,%s", config.ip, config.subnet,
		    config.gateway, config.dns);
	return 0;
}

static int command(const struct shell *sh, const char *name, char **args,
		   unsigned int count, bool *echo)
{
	if (!strcmp(name, "CONN")) {
		return join(sh, args, count);
	}
	if (!strcmp(name, "SCAN")) {
		struct winc_scan scan = { .sh = sh };
		int channel = count == 1 ? number(args[0], 14) : 0;
		if (count > 1 || channel < 0) {
			return -105;
		}
		int ret = wt_wifi_scan_visit(channel, scan_result, &scan);
		if (ret) {
			return ret == -ETIMEDOUT ? -111 : -250;
		}
		shell_print(sh, "+OK+SCAN=%u", scan.count);
		return 0;
	}
	if (!strcmp(name, "TCPCLI") || !strcmp(name, "UDP")) {
		return open_socket(sh, name[0] == 'U', args, count);
	}
	if (!strcmp(name, "RESDNS")) {
		struct zsock_addrinfo hints = { .ai_family = AF_INET, .ai_socktype = SOCK_STREAM };
		struct zsock_addrinfo *result;
		char address[16];

		if (count != 1 || !*args[0]) {
			return -103;
		}
		if (!wt_wifi_has_ipv4()) {
			return -206;
		}
		if (zsock_getaddrinfo(args[0], NULL, &hints, &result)) {
			return -107;
		}
		const struct sockaddr_in *peer = (const struct sockaddr_in *)result->ai_addr;
		zsock_inet_ntop(AF_INET, &peer->sin_addr, address, sizeof(address));
		zsock_freeaddrinfo(result);
		shell_print(sh, "+OK+RESDNS=%s,%s", args[0], address);
		return 0;
	}
	if (!strcmp(name, "CLOSE") || !strcmp(name, "UDPCFG") || !strcmp(name, "UDPCB")) {
		unsigned int expected = !strcmp(name, "CLOSE") ? 1 : !strcmp(name, "UDPCB") ? 2 : 3;
		if (count != expected) {
			return -103;
		}
		int id = existing_socket(args[0]);
		if (id < 0 || (expected > 1 && id < WINC_TCP_COUNT)) {
			return -300;
		}
		if (expected == 1) {
			close_socket(id);
		} else if (expected == 2) {
			int enable = number(args[1], 1);
			if (enable < 0) {
				return -105;
			}
			sockets[id].send_event = enable;
		} else if (parse_peer(&sockets[id].peer, args[1], args[2])) {
			return -301;
		}
	} else if (!strcmp(name, "ECHO")) {
		int mode = count == 1 ? number(args[0], 1) : -1;
		if (mode < 0) {
			return -105;
		}
		*echo = mode;
	} else if (!strcmp(name, "DHCP")) {
		int enable = count == 1 ? number(args[0], 1) : -1;

		if (enable != 1) {
			return enable == 0 ? -104 : -105;
		}
	} else if (count) {
		return -103;
	} else if (!strcmp(name, "VER")) {
		shell_print(sh, "+OK+VER=AT:" WT_WINC_AT_VERSION ",FW:WT02E40E");
		return 0;
	} else if (!strcmp(name, "LIST")) {
		shell_print(sh, "AT");
		for (size_t i = 0; i < ARRAY_SIZE(commands); ++i) {
			shell_print(sh, "AT+%s%s", commands[i].name, commands[i].args);
		}
		shell_print(sh, "+OK+LIST=%u", (unsigned int)ARRAY_SIZE(commands) + 1);
		return 0;
	} else if (!strcmp(name, "ECHO?")) {
		shell_print(sh, "+OK+ECHO=%d", *echo);
		return 0;
	} else if (!strcmp(name, "MODE")) {
		shell_print(sh, "+OK+MODE=%s", wt_wifi_is_associated() ? "STA" : "IDLE");
		return 0;
	} else if (!strcmp(name, "DISMODE")) {
		bool was_connected = wt_wifi_is_associated();
		if (wt_wifi_station_leave()) {
			return -107;
		}
		wt_winc_close_all();
		station_connected = false;
		shell_print(sh, "+OK+DISMODE");
		if (was_connected) {
			shell_print(sh, "+EVT+DISCONN");
		}
		return 0;
	} else if (!strcmp(name, "CLOSEALL")) {
		wt_winc_close_all();
	} else if (!strcmp(name, "GETMAC")) {
		char mac[18];
		if (wt_wifi_mac_get(mac, sizeof(mac))) {
			return -107;
		}
		shell_print(sh, "+OK+GETMAC=%s", mac);
		return 0;
	} else if (!strcmp(name, "GETIP")) {
		struct wt_wifi_ipv4_config config;
		if (wt_wifi_ipv4_config_get(&config)) {
			shell_print(sh, "+OK+GETIP=0.0.0.0");
		} else {
			shell_print(sh, "+OK+GETIP=%s,%s,%s,%s", config.ip, config.subnet,
				    config.gateway, config.dns);
		}
		return 0;
	} else if (!strcmp(name, "RSSI")) {
		struct wifi_iface_status status = { 0 };
		if (!wt_wifi_is_associated() || wt_wifi_station_status(&status)) {
			return -206;
		}
		shell_print(sh, "+OK+RSSI=%d", status.rssi);
		return 0;
	}
	shell_print(sh, "+OK+%s", name);
	return 0;
}

bool wt_winc_command(const struct shell *sh, char *line, bool *echo)
{
	char *args[4];
	char *name = line + 3;
	const char *equals;
	size_t len;

	if (strncasecmp(line, "AT+", 3)) {
		return false;
	}
	equals = strchr(name, '=');
	len = equals ? (size_t)(equals - name) : strlen(name);
	for (size_t index = 0; index < ARRAY_SIZE(commands); ++index) {
		const char *canonical = commands[index].name;
		if (strlen(canonical) != len || strncasecmp(canonical, name, len)) {
			continue;
		}
		unsigned int count = equals ? split_fields(name + len + 1, args, ARRAY_SIZE(args)) : 0;
		int ret = command(sh, canonical, args, count, echo);
		if (ret) {
			shell_print(sh, "+ERROR+%s:%d", canonical, ret);
		}
		return true;
	}
	return false;
}
```

## src/wt_winc_at.h
```c
#ifndef WT_WINC_AT_H
#define WT_WINC_AT_H

#include <stdbool.h>
#include <zephyr/shell/shell.h>

#include "wt_winc_wire.h"

#define WT_WINC_AT_VERSION "0.1.0"

bool wt_winc_command(const struct shell *sh, char *line, bool *echo);
void wt_winc_stream_command(const struct shell *sh, const struct wt_winc_frame *frame);
void wt_winc_close_all(void);
void wt_winc_service(const struct shell *sh);

#endif
```

## src/wt_winc_wire.c
```c
#include "wt_winc_wire.h"

enum wt_winc_sync_result wt_winc_sync_feed(size_t *matched, uint8_t byte)
{
	static const uint8_t start[WT_WINC_SYNC_LENGTH] = {0xa5, 0x01, 0xf2, 0x00, 0x00, 0x0c, 0x00,
					0x0c, 0x00, 0x61, 0x2f, 0x52, 0xef};

	if (byte != start[*matched]) {
		*matched = byte == start[0] ? 1 : 0;
		return *matched ? WT_WINC_PREFIX : WT_WINC_TEXT;
	}
	if (++*matched == sizeof(start)) {
		*matched = 0;
		return WT_WINC_SYNC;
	}
	return WT_WINC_PREFIX;
}

int wt_winc_socket_digit(char c)
{
	if (c >= '0' && c <= '9') {
		return c - '0';
	}
	return c == 'A' || c == 'a' ? 10 : -1;
}

/* Consume the declared length before looking for SOH E. Both bytes are
 * legal inside a payload. The caller resets the frame on error or timeout.
 */
enum wt_winc_frame_result wt_winc_frame_feed(struct wt_winc_frame *frame, uint8_t byte)
{
	size_t pos = frame->used;

	if (pos == sizeof(frame->data)) {
		return WT_WINC_BAD_DATA;
	}
	frame->data[frame->used++] = byte;
	if (pos == 0) {
		frame->directive = byte;
		return byte == 'S' || byte == 'U' || byte == 'R' ? WT_WINC_MORE : WT_WINC_BAD_HEADER;
	}
	if (pos == 1) {
		frame->socket = wt_winc_socket_digit(byte);
		if (frame->socket < 0) {
			return WT_WINC_BAD_HEADER;
		}
		if (frame->directive == 'R') {
			frame->payload_start = frame->used;
		}
		return WT_WINC_MORE;
	}
	if (frame->directive != 'R' && pos < 6) {
		if (byte < '0' || byte > '9') {
			return WT_WINC_BAD_HEADER;
		}
		frame->payload_len = frame->payload_len * 10 + byte - '0';
		if (pos == 5) {
			if (!frame->payload_len || frame->payload_len > WT_WINC_PAYLOAD_MAX) {
				return WT_WINC_BAD_HEADER;
			}
			if (frame->directive == 'S') {
				frame->payload_start = frame->used;
			}
		}
		return WT_WINC_MORE;
	}
	if (!frame->payload_start) {
		if (pos >= 30 || (pos == 6 && byte != ',') ||
		    (byte != ',' && byte != '.' && (byte < '0' || byte > '9'))) {
			return WT_WINC_BAD_HEADER;
		}
		if (byte == ',' && ++frame->commas == 3) {
			frame->payload_start = frame->used;
		}
		return WT_WINC_MORE;
	}

	size_t end = frame->payload_start + frame->payload_len;
	if (pos < end) {
		return WT_WINC_MORE;
	}
	if (pos == end) {
		return byte == WT_WINC_SOH ? WT_WINC_MORE : WT_WINC_BAD_DATA;
	}
	return byte == 'E' ? WT_WINC_FRAME : WT_WINC_BAD_DATA;
}
```

## src/wt_winc_wire.h
```c
#ifndef WT_WINC_WIRE_H
#define WT_WINC_WIRE_H

#include <stddef.h>
#include <stdint.h>

#define WT_WINC_SOH 0x01
#define WT_WINC_ETB 0x17
#define WT_WINC_SYNC_LENGTH 13
#define WT_WINC_PAYLOAD_MAX 1400

enum wt_winc_sync_result { WT_WINC_TEXT, WT_WINC_PREFIX, WT_WINC_SYNC };
enum wt_winc_frame_result { WT_WINC_MORE, WT_WINC_FRAME, WT_WINC_BAD_HEADER, WT_WINC_BAD_DATA };

struct wt_winc_frame {
	uint8_t data[WT_WINC_PAYLOAD_MAX + 32];
	size_t used;
	size_t payload_start;
	size_t payload_len;
	unsigned int commas;
	char directive;
	int socket;
};

enum wt_winc_sync_result wt_winc_sync_feed(size_t *matched, uint8_t byte);
enum wt_winc_frame_result wt_winc_frame_feed(struct wt_winc_frame *frame, uint8_t byte);
int wt_winc_socket_digit(char c);

#endif
```
